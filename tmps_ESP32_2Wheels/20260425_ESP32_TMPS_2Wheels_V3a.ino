/* TMPS - 2 Wheels by JS - Version V3 (Cleaned)
 
V2
# die Namen der devices werden nicht mehr gefunden, daher nur nach adresse suchen
# Normaler Luftdruck sollte weg sein

based on 
https://www.youtube.com/upir_upir
YouTube Video: https://youtu.be/P85tkCbQGo8
Source Files: https://github.com/upiir/arduino_tpms_tire_pressure

* Only 2 sensors for motor bike
* if sensor were detected the display part of the sensor will be inverted
  after timeout (e.g. 30 sec) the screen part will be normal
* pressure in bar, without 1 bar normal air pressure!
* voltage and temperature of the sensors 

ESP32-C3 Connections
OLED        XIAO      ESP32C3 supermini
GND       2. vo.Re      2. vo.ReVcc 3,3V  3. vo.Re      3. vo.Re
Vcc 3,3V  3. vo.Re      3. vo.Re
SCL       2. vu.Li      4. vu.li  IP 9
SDA       3. vu.Li      5. vu.Li  IO 8

*/

#include <Arduino.h>
#include <BLEDevice.h>
#include <BLEUtils.h>
#include <BLEScan.h>
#include <BLEAdvertisedDevice.h>
#include <U8g2lib.h>

// Display Initialisierung
U8G2_SSD1306_128X64_NONAME_F_HW_I2C u8g2(U8G2_R3, /*reset=*/ U8X8_PIN_NONE);

struct TPMSData {
  String address;
  float pressure;
  int temperature;
  float voltage;
  unsigned long lastUpdate;
  bool newDataAvailable;
};

// Deine Sensor-Adressen
TPMSData vorne  = {"3b:5c:00:00:83:42", 0, 0, 0, 0, false};
TPMSData hinten = {"3b:7d:00:00:47:2a", 0, 0, 0, 0, false};

BLEScan* pBLEScan;
int scanTime = 2; //5; 

// Zero Motorcycle logo
#define zero_logo_width 64
#define zero_logo_height 64
static const unsigned char zero_logo_bits[] U8X8_PROGMEM = {
  0x00, 0x00, 0x00, 0x00, 0x00, 0x00, 0x00, 0x00, 0x00, 0x00, 0x00, 0x00,
  0x00, 0x00, 0x00, 0x00, 0x00, 0x00, 0x00, 0x00, 0x00, 0x00, 0x00, 0x00,
  0x00, 0x00, 0x00, 0x00, 0x00, 0x00, 0x00, 0x00, 0x00, 0x00, 0x00, 0x00,
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  0x00, 0x00, 0x00, 0x00, 0x00, 0x00, 0x00, 0x00
};

// Zentrale Anzeige-Funktion
void draw_values(int offset, int invertiert, float druck, int temp, float volt) {
  u8g2.setFontMode(1); 

  if (invertiert == 1) {
    u8g2.setDrawColor(1);  /* color 1 for the box */
    u8g2.drawRBox(0, 1 + offset, 63, 61, 4);
    u8g2.setDrawColor(0);
  } else {
    u8g2.setDrawColor(0);  /* color 0 for the box */
    u8g2.drawRBox(0, 1 + offset, 63, 61, 4);
    u8g2.setDrawColor(1);
  }

  u8g2.setFont(u8g2_font_helvB18_tf);
  u8g2.setCursor(5, 24 + offset);
  u8g2.print(String(druck, 1) + " b");
  u8g2.setFont(u8g2_font_helvB14_tf);
  u8g2.setCursor(10, 43 + offset);
  u8g2.print(String(temp) + " °C");
  u8g2.setFont(u8g2_font_helvB08_tf);
  u8g2.setCursor(15, 57 + offset);
  u8g2.print(String(volt, 1) + " V");
  u8g2.sendBuffer();
}

class MyAdvertisedDeviceCallbacks : public BLEAdvertisedDeviceCallbacks {
  void onResult(BLEAdvertisedDevice advertisedDevice) {
    String foundAddr = advertisedDevice.getAddress().toString().c_str();
    TPMSData* target = nullptr;

    if (foundAddr == vorne.address) target = &vorne;
    else if (foundAddr == hinten.address) target = &hinten;

    if (target != nullptr && advertisedDevice.haveManufacturerData()) {
      String strData = advertisedDevice.getManufacturerData();
      const uint8_t* cData = (const uint8_t*)strData.c_str();

      if (strData.length() >= 5) {
        target->voltage = (float)cData[1] / 10.0;
        target->temperature = cData[2];
        uint16_t raw_psi = (uint16_t)cData[3] << 8 | cData[4];
        target->pressure = ((float)raw_psi / 10.0) / 14.50377;
        
        if (target->pressure < 0) target->pressure = 0;
        target->lastUpdate = millis();
        target->newDataAvailable = true;

        
        Serial.printf("Update von %s: %.1f bar\n", foundAddr.c_str(), target->pressure);

      //for (int i = 0; i < strManufacturerData.length(); i++) { // print individual bytes of the manufacturer data
      //  Serial.printf("[%02X]", cManufacturerData[i]); // %02 means pad the value with zeros to have at least two digits, X is the byte
      //}
      // Received Manufacturers Data Example
      // [80] [1f] [1a] [00] [92] [14] [74]
      // meaning:
      // 80 - status - ignore for now
      // 1f - battery voltage - 0x1f hex = 31 = 3.1V
      // 1a - temperature 0x1a hex = 26°C
      // 0092 - pressure 0x0092 hex = 146 = 14.6 psi
      // 14 74 - checksum - ignore for now
      }
    }
  }
};

void setup(void) {
  Serial.begin(115200);
  Serial.println();
  Serial.println(__FILE__ " " __DATE__ " " __TIME__);
  
  u8g2.begin();
  u8g2.enableUTF8Print();
  u8g2.setFlipMode(1);
  u8g2.setFont(u8g2_font_helvB12_tf);
  u8g2.setCursor(10, 16);
  u8g2.print("Norm.");
  u8g2.setCursor(7, 34);
  u8g2.print("V 2.2 b");
  u8g2.setCursor(7, 50);
  u8g2.print("H 2.3 b");
  u8g2.drawXBMP(
    0,   // x-Position
    64,  // y-Position
    zero_logo_width,
    zero_logo_height,
    zero_logo_bits);
  u8g2.sendBuffer();

  Serial.println("Scanning ...");

  BLEDevice::init("");
  pBLEScan = BLEDevice::getScan();
  pBLEScan->setAdvertisedDeviceCallbacks(new MyAdvertisedDeviceCallbacks());
  pBLEScan->setActiveScan(true);
  pBLEScan->setInterval(100);
  pBLEScan->setWindow(99);
}

void loop(void) {
  if (!pBLEScan->isScanning()) {
    pBLEScan->start(scanTime, nullptr, false); 
  }

  if (vorne.newDataAvailable) {
    draw_values(0, 1, vorne.pressure, vorne.temperature, vorne.voltage);
    vorne.newDataAvailable = false;
    
    Serial.println("Vorne updated");
    Serial.print("Pressure (b/psi): ");
    Serial.println(String(vorne.pressure, 1));
    Serial.print("Temperature (°C): ");
    Serial.println(vorne.temperature);
    Serial.print("Voltage (V)     : ");
    Serial.println(vorne.voltage);
    Serial.println();
  } else if (vorne.lastUpdate != 0 && (millis() - vorne.lastUpdate > 10000)) {
    draw_values(0, 0, vorne.pressure, vorne.temperature, vorne.voltage);
    vorne.lastUpdate = 0;
  }

  if (hinten.newDataAvailable) {
    draw_values(64, 1, hinten.pressure, hinten.temperature, hinten.voltage);
    hinten.newDataAvailable = false;

    Serial.println("Hinten updated");
    Serial.print("Pressure (b/psi): ");
    Serial.println(String(hinten.pressure, 1));
    Serial.print("Temperature (°C): ");
    Serial.println(hinten.temperature);
    Serial.print("Voltage (V)     : ");
    Serial.println(hinten.voltage);
    Serial.println();
  } else if (hinten.lastUpdate != 0 && (millis() - hinten.lastUpdate > 10000)) {
    draw_values(64, 0, hinten.pressure, hinten.temperature, hinten.voltage);
    hinten.lastUpdate = 0;
  }

  delay(100);
}
